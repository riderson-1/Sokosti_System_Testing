## CMakeLists.txt
```
#
# Copyright (c) 2020 Nordic Semiconductor
#
# SPDX-License-Identifier: LicenseRef-Nordic-5-Clause
#

cmake_minimum_required(VERSION 3.20.0)

find_package(Zephyr REQUIRED HINTS $ENV{ZEPHYR_BASE})
project(sokosti_system_integration_test)

# NORDIC SDK APP START
target_sources(app PRIVATE
    app/src/main.cpp
    drivers/bhi360/bhi360_driver.cpp
    app/src/threads.cpp
    app/src/ble/ble_nus.cpp
    app/src/usb/usb_cdc.cpp
    app/src/usb/sample_usbd_init.c
    app/src/sd_log_backend.cpp
    drivers/ads1299/ads1299_driver.cpp
    drivers/ads1299/ads1299_configs.cpp
)

file(GLOB BHY2_SOURCES
    "${CMAKE_CURRENT_SOURCE_DIR}/drivers/bhi360/BHY2-Sensor-API/*.c"
)

target_sources(app PRIVATE ${BHY2_SOURCES})
target_include_directories(app PRIVATE
    ${CMAKE_CURRENT_SOURCE_DIR}/app/src
    ${CMAKE_CURRENT_SOURCE_DIR}/app/src/ble
    ${CMAKE_CURRENT_SOURCE_DIR}/app/src/usb
    ${CMAKE_CURRENT_SOURCE_DIR}/drivers/ads1299
    ${CMAKE_CURRENT_SOURCE_DIR}/drivers/bhi360
    ${CMAKE_CURRENT_SOURCE_DIR}/drivers/bhi360/BHY2-Sensor-API
)
target_compile_definitions(app PRIVATE
    BHY2_CFG_DELEGATE_FIFO_PARSE_CB_INFO_MGMT=0
)
# NORDIC SDK APP END
```

## Kconfig
```
rsource "app/src/usb/Kconfig.sample_usbd"

source "Kconfig.zephyr"
```

## Kconfig.sysbuild
```
# Enable the nRF5340 network core IPC radio image for Bluetooth HCI.
# This file is consumed by sysbuild, not by the application image.

config NRF_DEFAULT_IPC_RADIO
	default y

config NETCORE_IPC_RADIO_BT_HCI_IPC
	default y

source "share/sysbuild/Kconfig"
```

## prj.conf
```kconfig
#
# Copyright (c) 2020 Nordic Semiconductor ASA
#
# SPDX-License-Identifier: LicenseRef-Nordic-5-Clause
#

CONFIG_CPP=y
CONFIG_STD_CPP17=y

CONFIG_GPIO=y
CONFIG_SPI=y
CONFIG_NRFX_SPIM=y
CONFIG_NRFX_CLOCK=y
CONFIG_FPU=y
CONFIG_FP_HARDABI=y

CONFIG_PRINTK=y
CONFIG_PWM=y

CONFIG_MULTITHREADING=y
CONFIG_SYS_CLOCK_EXISTS=y
CONFIG_POLL=y

CONFIG_USE_SEGGER_RTT=y
CONFIG_RTT_CONSOLE=y
CONFIG_SEGGER_RTT_BUFFER_SIZE_UP=4096

# USB CDC-ACM (primary transport when a host has the port open)
CONFIG_USB_DEVICE_STACK_NEXT=y
CONFIG_SERIAL=y
CONFIG_UART_LINE_CTRL=y
CONFIG_USBD_CDC_ACM_CLASS=y
CONFIG_CDC_ACM_SERIAL_INITIALIZE_AT_BOOT=n
CONFIG_USBD_LOG_LEVEL_ERR=y
CONFIG_UDC_DRIVER_LOG_LEVEL_ERR=y
CONFIG_USBD_CDC_ACM_LOG_LEVEL_OFF=y
CONFIG_SAMPLE_USBD_VID=0x2FE3
CONFIG_SAMPLE_USBD_PID=0x0001
CONFIG_SAMPLE_USBD_MANUFACTURER="Your Company"
CONFIG_SAMPLE_USBD_PRODUCT="USBD CDC ACM Sokosti Test"
CONFIG_SAMPLE_USBD_MAX_POWER=125

# Bluetooth peripheral and Nordic UART Service
CONFIG_BT=y
CONFIG_BT_PERIPHERAL=y
CONFIG_BT_NUS=y
CONFIG_BT_DEVICE_NAME="Sokosti_BLE"
CONFIG_BT_MAX_CONN=1
CONFIG_BT_GATT_CLIENT=y

# Allow the app to request a 2M PHY update and Data Length Extension (DLE)
# for higher BLE throughput.
CONFIG_BT_USER_PHY_UPDATE=y
CONFIG_BT_USER_DATA_LEN_UPDATE=y

# The NCS 3.3 Bluetooth RX workqueue can overflow during MTU exchange and
# notification subscription when large ATT buffers are enabled.
CONFIG_BT_RX_STACK_SIZE=4096
CONFIG_BT_HCI_TX_STACK_SIZE=2048

# Large notifications: ATT MTU 498, split by the controller into DLE packets.
CONFIG_BT_L2CAP_TX_MTU=247
CONFIG_BT_BUF_ACL_RX_SIZE=502
CONFIG_BT_BUF_ACL_TX_SIZE=502
CONFIG_BT_CTLR_DATA_LENGTH_MAX=251
# TX buffer credits: raise to reduce -ENOMEM (buffer starvation) during
# high-throughput streaming. Each credit is one ACL TX buffer.
# NOTE: Zephyr asserts CONFIG_BT_BUF_EVT_RX_COUNT > CONFIG_BT_BUF_ACL_TX_COUNT,
# so EVT_RX must be bumped alongside TX.
CONFIG_BT_BUF_ACL_TX_COUNT=20
CONFIG_BT_BUF_EVT_RX_COUNT=24
CONFIG_BT_L2CAP_TX_BUF_COUNT=20

# Enable logging
CONFIG_LOG=y
CONFIG_LOG_MODE_IMMEDIATE=y

# enable debugging
CONFIG_DEBUG_OPTIMIZATIONS=y
CONFIG_DEBUG_THREAD_INFO=y

# Thread stack usage analyzer
CONFIG_THREAD_ANALYZER=y
CONFIG_THREAD_ANALYZER_AUTO=y
CONFIG_THREAD_ANALYZER_AUTO_INTERVAL=5
# The analyzer thread formats and prints per-thread info; give it a generous
# stack so it doesn't overflow (default 1024/2048 is too tight with
# DEBUG_THREAD_INFO + THREAD_NAME enabled).
CONFIG_THREAD_ANALYZER_AUTO_STACK_SIZE=4096
CONFIG_THREAD_NAME=y

# Bump main stack size to accommodate SPI init and FIFO processing
CONFIG_MAIN_STACK_SIZE=4096

# File System and SD Card Support
CONFIG_DISK_ACCESS=y
CONFIG_FILE_SYSTEM=y
CONFIG_FAT_FILESYSTEM_ELM=y
CONFIG_FS_FATFS_NUM_FILES=2
CONFIG_FS_FATFS_NUM_DIRS=1
# Support long filenames (session_0001.bin is > 8.3)
CONFIG_FS_FATFS_LFN=y
# LFN working buffer lives on the heap
# (optional — see note below)
# CONFIG_FATFS_HEAP_WORK_BUF=y 

# Ensure C++ standard math is available
CONFIG_NEWLIB_LIBC=y
```

## dts/bindings/spi/bosch,bhi360.yaml
```yaml
description: Bosch BHI360 IMU Sensor

compatible: "bosch,bhi360"

include: spi-device.yaml

properties:
  int-gpios:
    type: phandle-array
    description: |
      GPIO used for data ready interrupt.
      The pin should be configured as active high or active low based on sensor configuration.
```

## src/main.c
```c
/**
 * @file main.c
 * @author your name (you@domain.com)
 * @brief 
 * @version 0.1
 * @date 2026-07-07
 * 
 * @copyright Copyright (c) 2026
 * 
 */

#include <zephyr/kernel.h>
#include <zephyr/sys/printk.h>
#include <zephyr/drivers/spi.h>
#include <zephyr/drivers/gpio.h>
#include <zephyr/drivers/pwm.h>
#include <zephyr/devicetree.h>
#include <errno.h>
#include <stdint.h>
#include <stddef.h>
#include <string.h>

#include <stdio.h>
#include <zephyr/device.h>
#include <zephyr/drivers/uart.h>
#include <zephyr/logging/log.h>
#include <zephyr/usb/usbd.h>

#include "sample_usbd.h"
#include "ads1299_definitions.h"
#include "ads1299_driver.h"

LOG_MODULE_REGISTER(cdc_acm_print, LOG_LEVEL_INF);

#define LOOP_DELAY_MS 1000

#define ADS_NODE        DT_NODELABEL(ads1299)
#define LED_NODE        DT_ALIAS(led0)
#define RESET_NODE      DT_NODELABEL(reset_ads)
#define START_NODE      DT_NODELABEL(global_start)
#define DRDY_NODE       DT_NODELABEL(drdy_ads)
#define ADS_CLK_NODE    DT_ALIAS(adsclk)

const struct device *const uart_dev = DEVICE_DT_GET_ONE(zephyr_cdc_acm_uart);

static struct usbd_context *sample_usbd;
K_SEM_DEFINE(dtr_sem, 0, 1);

static void sample_msg_cb(struct usbd_context *const ctx, const struct usbd_msg *msg)
{
	LOG_INF("USBD message: %s", usbd_msg_type_string(msg->type));

	if (usbd_can_detect_vbus(ctx)) {
		if (msg->type == USBD_MSG_VBUS_READY) {
			if (usbd_enable(ctx)) {
				LOG_ERR("Failed to enable device support");
			}
		}
		if (msg->type == USBD_MSG_VBUS_REMOVED) {
			if (usbd_disable(ctx)) {
				LOG_ERR("Failed to disable device support");
			}
		}
	}

	if (msg->type == USBD_MSG_CDC_ACM_CONTROL_LINE_STATE) {
		uint32_t dtr = 0U;

		uart_line_ctrl_get(msg->dev, UART_LINE_CTRL_DTR, &dtr);
		if (dtr) {
			k_sem_give(&dtr_sem);
		}
	}
}

static int enable_usb_device_next(void)
{
	int err;

	sample_usbd = sample_usbd_init_device(sample_msg_cb);
	if (sample_usbd == NULL) {
		LOG_ERR("Failed to initialize USB device");
		return -ENODEV;
	}

	if (!usbd_can_detect_vbus(sample_usbd)) {
		err = usbd_enable(sample_usbd);
		if (err) {
			LOG_ERR("Failed to enable device support");
			return err;
		}
	}

	LOG_INF("USB device support enabled");
	return 0;
}

static void cdc_print(const char *msg, size_t len)
{
    for (size_t i = 0; i < len; i++) {
        uart_poll_out(uart_dev, msg[i]);
    }
}

/*
 * ADS1299 SPI timing is CPOL = 0, CPHA = 1 according to the datasheet [14].
 */
static const struct spi_dt_spec ads_spi =
    SPI_DT_SPEC_GET(ADS_NODE,
            SPI_WORD_SET(8) | SPI_TRANSFER_MSB | SPI_MODE_CPHA);

static const struct gpio_dt_spec led =
    GPIO_DT_SPEC_GET(LED_NODE, gpios);

static const struct gpio_dt_spec reset_pin =
    GPIO_DT_SPEC_GET(RESET_NODE, gpios);

static const struct gpio_dt_spec start_pin =
    GPIO_DT_SPEC_GET(START_NODE, gpios);

static const struct gpio_dt_spec drdy_pin =
    GPIO_DT_SPEC_GET(DRDY_NODE, gpios);

static const struct pwm_dt_spec ads_clk_pwm =
    PWM_DT_SPEC_GET(ADS_CLK_NODE);

static K_SEM_DEFINE(drdy_sem, 0, 1);
static struct gpio_callback drdy_cb_data;

static void drdy_isr(const struct device *dev, struct gpio_callback *cb, uint32_t pins)
{
    k_sem_give(&drdy_sem);
}

static int setup_drdy_interrupt(void)
{
    int ret = gpio_pin_interrupt_configure_dt(&drdy_pin, GPIO_INT_EDGE_FALLING);
    if (ret) {
        return ret;
    }

    gpio_init_callback(&drdy_cb_data, drdy_isr, BIT(drdy_pin.pin));
    gpio_add_callback(drdy_pin.port, &drdy_cb_data);

    return 0;
}

static int start_ads_pwm_clock(void)
{
    if (!pwm_is_ready_dt(&ads_clk_pwm)) {
        printk("ADS clock PWM not ready\n");
        return -ENODEV;
    }

    /*
     * ~2 MHz: 500 ns period, 250 ns pulse.
     * ADS1299 typical external fCLK is 2.048 MHz in datasheet examples [14].
     */
    int ret = pwm_set_dt(&ads_clk_pwm, PWM_NSEC(500), PWM_NSEC(250));
    if (ret) {
        printk("PWM start failed: %d\n", ret);
        return ret;
    }

    printk("ADS clock PWM started\n");
    return 0;
}

static int setup_gpios(void)
{
    int ret;

    if (!gpio_is_ready_dt(&led) ||
        !gpio_is_ready_dt(&reset_pin) ||
        !gpio_is_ready_dt(&start_pin) ||
        !gpio_is_ready_dt(&drdy_pin)) {
        printk("GPIO not ready\n");
        return -ENODEV;
    }

    ret = gpio_pin_configure_dt(&led, GPIO_OUTPUT_INACTIVE);
    if (ret) {
        return ret;
    }

    ret = gpio_pin_configure_dt(&reset_pin, GPIO_OUTPUT_INACTIVE);
    if (ret) {
        return ret;
    }

    ret = gpio_pin_configure_dt(&start_pin, GPIO_OUTPUT_INACTIVE);
    if (ret) {
        return ret;
    }

    ret = gpio_pin_configure_dt(&drdy_pin, GPIO_INPUT);
    if (ret) {
        return ret;
    }

    return 0;
}

int main(void)
{
    int ret;
    uint8_t id = 0;
    uint8_t frame[ADS_FRAME_BYTES];
    uint32_t sample_idx = 0;

    if (!device_is_ready(uart_dev)) {
        LOG_ERR("CDC ACM device not ready");
        return 0;
    }

    ret = enable_usb_device_next();
    if (ret != 0) {
        LOG_ERR("Failed to enable USB device support");
        return 0;
    }

    LOG_INF("Wait for DTR");
    k_sem_take(&dtr_sem, K_MSEC(500));
    LOG_INF("DTR set");

    k_msleep(100);

    k_sleep(K_MSEC(500));
    printk("ADS1299 internal test signal capture starting...\n");

    if (!spi_is_ready_dt(&ads_spi)) {
        printk("SPI device not ready\n");
        return 0;
    }

    ret = setup_gpios();
    if (ret) {
        printk("GPIO setup failed: %d\n", ret);
        return 0;
    }

    ret = setup_drdy_interrupt();
    if (ret) {
        printk("DRDY interrupt setup failed: %d\n", ret);
        return 0;
    }

    /*
     * Keep START pin low and use the SPI START command.
     * Datasheet says when using START command, hold START pin low [9], [27].
     */
    gpio_pin_set_dt(&start_pin, 0);

    ret = start_ads_pwm_clock();
    if (ret) {
        printk("Warning: ADS clock not running: %d\n", ret);
    }

    k_sleep(K_MSEC(20));

    ads_hw_reset();

    ret = ads_send_cmd(CMD_RESET);
    if (ret) {
        printk("CMD_RESET failed: %d\n", ret);
        return 0;
    }

    /*
     * RESET command requires 18 tCLK cycles; wait longer than required [8], [26].
     */
    k_sleep(K_MSEC(10));

    ret = ads_read_id(&id);
    if (ret) {
        printk("ADS1299 ID read failed: %d\n", ret);
        return 0;
    }

    printk("ADS1299 ID: 0x%02X\n", id);

    /* ret = ads_configure_internal_test_signal();
    if (ret) {
        printk("ADS test signal configuration failed: %d\n", ret);
        return 0;
    } */

    ret = ads_configure_external_inputs_all();
    if (ret) {
        printk("ADS external input configuration failed: %d\n", ret);
        return 0;
    }


    /*
     * Dump registers before RDATAC. Register access should be done outside
     * RDATAC mode.
     */
    ret = ads_dump_test_regs();
    if (ret) {
        printk("ADS register dump failed: %d\n", ret);
        return 0;
    }

    ads_send_cmd(CMD_SDATAC);
    k_sleep(K_MSEC(2));

    ret = ads_configure_external_inputs_all();
    if (ret) {
        printk("ADS external input configuration failed: %d\n", ret);
        return 0;
    }

    ads_send_cmd(CMD_RDATAC);
    k_sleep(K_MSEC(2));

    ads_send_cmd(CMD_START);
    k_sleep(K_MSEC(20));

    //printk("Streaming internal test signal. Expect ~1 Hz square wave.\n");
    //printk("Polling DRDY and reading %d-byte frames.\n", ADS_FRAME_BYTES);

    /* Send once, before entering the loop */
    static const char hdr[] = "sample,status_ok,ch1,ch2,ch3,ch4,ch5,ch6,ch7,ch8\r\n";
    cdc_print(hdr, sizeof(hdr) - 1);

    while (1) {
        k_sem_take(&drdy_sem, K_FOREVER);
        ret = ads_read_frame_rdatac(frame);
        if (ret) {
            printk("Frame read failed: %d\n", ret);
            gpio_pin_toggle_dt(&led);
            continue;
        }

        bool status_header_ok = ((frame[0] & 0xF0) == 0xC0);
        int32_t ch1 = ads_decode24(&frame[3]);
        int32_t ch2 = ads_decode24(&frame[6]);
        int32_t ch3 = ads_decode24(&frame[9]);
        int32_t ch4 = ads_decode24(&frame[12]);
        int32_t ch5 = ads_decode24(&frame[15]);
        int32_t ch6 = ads_decode24(&frame[18]);
        int32_t ch7 = ads_decode24(&frame[21]);
        int32_t ch8 = ads_decode24(&frame[24]);

        char msg[96];
        int len = snprintf(msg, sizeof(msg),
            "%lu,%d,%ld,%ld,%ld,%ld,%ld,%ld,%ld,%ld\r\n",
            (unsigned long)sample_idx,
            status_header_ok ? 1 : 0,
            (long)ch1, (long)ch2, (long)ch3, (long)ch4,
            (long)ch5, (long)ch6, (long)ch7, (long)ch8);
        cdc_print(msg, len);

        if ((sample_idx % 250U) == 0U) {
            gpio_pin_toggle_dt(&led);   /* heartbeat, once per second */
        }

        sample_idx++;
    }

    return 0;
}
```

## src/main.cpp
```c
/**
 * @file main.cpp
 * @brief ADS1299 EMG acquisition entry point, streaming CSV over USB CDC-ACM.
 * @version 0.2
 * @date 2026-07-08
 */

#include <zephyr/kernel.h>
#include <zephyr/device.h>
#include <zephyr/drivers/spi.h>
#include <zephyr/drivers/gpio.h>
#include <zephyr/drivers/pwm.h>
#include <zephyr/devicetree.h>
#include <zephyr/logging/log.h>

#include <errno.h>
#include <stdint.h>
#include <stddef.h>
#include <stdio.h>

#include "ads1299_definitions.h"
#include "ads1299_driver.hpp"
#include "usb_cdc.hpp"
#include "ads1299_configs.hpp"
#include "threads.hpp"
#include "bhi360_driver.hpp"

/*
 * Devicetree aliases / node labels for the Sokosti board.
 * LED is kept here (used by threads); the rest are passed to ADS1299.
 */
#define ADS_NODE        DT_NODELABEL(ads1299)
#define LED_NODE        DT_ALIAS(led0)
#define RESET_NODE      DT_NODELABEL(reset_ads)
#define START_NODE      DT_NODELABEL(global_start)
#define DRDY_NODE       DT_NODELABEL(drdy_ads)
#define ADS_CLK_NODE    DT_ALIAS(adsclk)

/*
 * ADS1299 SPI timing is CPOL = 0, CPHA = 1 according to the datasheet [14].
 */
static const struct spi_dt_spec ads_spi =
    SPI_DT_SPEC_GET(ADS_NODE,
            SPI_WORD_SET(8) | SPI_TRANSFER_MSB | SPI_MODE_CPHA);

const struct gpio_dt_spec led =
    GPIO_DT_SPEC_GET(LED_NODE, gpios);

static const struct gpio_dt_spec reset_pin =
    GPIO_DT_SPEC_GET(RESET_NODE, gpios);

static const struct gpio_dt_spec start_pin =
    GPIO_DT_SPEC_GET(START_NODE, gpios);

static const struct gpio_dt_spec drdy_pin =
    GPIO_DT_SPEC_GET(DRDY_NODE, gpios);

static const struct pwm_dt_spec ads_clk_pwm =
    PWM_DT_SPEC_GET(ADS_CLK_NODE);

/* Single ADS1299 instance — all board pins are bound at construction. */
ADS1299 ads(ads_spi, reset_pin, start_pin, drdy_pin, led, ads_clk_pwm);

static ADS1299Settings cfg = makeAdsSettings(AdsPreset::AllChannelsMeasurement);

LOG_MODULE_REGISTER(main, LOG_LEVEL_DBG);

int32_t last_ch1_code = 0;

int main(void)
{
    int ret;
    uint8_t id = 0;

    // ---------------------------------------
    // USB CDC (host communication)
    // ---------------------------------------

    ret = usb_cdc::init();
    if (ret != 0) {
        LOG_ERR("USB CDC init failed: %d", ret);
        return 0;
    }

    k_msleep(100);
    LOG_INF("ADS1299 internal test signal capture starting...");

    // ---------------------------------------
    // Board bring-up — GPIOs, DRDY IRQ, PWM clock
    // ---------------------------------------

    ret = ads.boardBringUp();
    if (ret) {
        LOG_ERR("Board bring-up failed: %d", ret);
        return 0;
    }

    k_sleep(K_MSEC(500));

    // ---------------------------------------
    // ADS1299 initialisation & configuration
    // ---------------------------------------

    ret = ads.init(&id);
    if (ret) {
        LOG_ERR("ADS1299 init failed: %d", ret);
        return ret;
    }
    
    ret = ads.configure(cfg);
    if (ret) {
        LOG_ERR("ADS configuration failed: %d", ret);
        return ret;
    }

    /*
     * Dump registers before RDATAC. Register access should be done outside
     * RDATAC mode.
     */
    ret = ads.dumpTestRegisters();
    if (ret) {
        LOG_ERR("ADS register dump failed: %d", ret);
        return 0;
    }

    // ret = ads.dumpTestRegistersUsb();
    // if (ret) {
    //     LOG_ERR("ADS register dump failed: %d", ret);
    //     return 0;
    // }

    ret = ads.startContinuousRead();
    if (ret) {
        LOG_ERR("ADS RDATAC failed: %d", ret);
        return 0;
    }

    ret = ads.startConversions();
    if (ret) {
        LOG_ERR("ADS START failed: %d", ret);
        return 0;
    }

    // ---------------------------------------
    // BHI360 initialisation (independent nrfx_spim path)
    // ---------------------------------------

    bhi360_init();

    // create RTOS threads
    threads_setup();



    // ---------------------------------------
    // main loop
    // ---------------------------------------

    while (true) {
        k_sleep(K_SECONDS(1));
    }

    return 0;
}
```

## src/ads1299_configs.cpp
```c
#include "ads1299_configs.hpp"

/**
 * @brief 
 * 
 * @return ADS1299Settings 
 */

static ADS1299Settings DefaultSettings()
{
    ADS1299Settings cfg;                 // start from struct defaults
    return cfg;
}

static ADS1299Settings SingleChannelTest()
{
    ADS1299Settings cfg;

    cfg.channel[0].powerDown = 0;
    cfg.channel[0].gain = 8;
    cfg.channel[0].mux = 0;
    cfg.channel[0].srb2 = 0;
    
    
    for (size_t i = 1; i < ADS_NUM_CHANNELS; i++)
    {
        cfg.channel[i].powerDown = 1;
    }
    
    cfg.device.nDaisyChain = 0;
    cfg.device.samplingRate = 1000;
    cfg.device.nPdBias = 1;

    return cfg;
}

static ADS1299Settings AllChannelsMeasurement()
{
    ADS1299Settings cfg;
    
    for (size_t i = 0; i < ADS_NUM_CHANNELS; i++)
    {
        cfg.channel[i].powerDown = 0;
        cfg.channel[i].gain = 8;
        cfg.channel[i].mux = 0;
        cfg.channel[i].srb2 = 0;
        
    }
    
    cfg.device.nDaisyChain = 0;
    cfg.device.samplingRate = 1000;
    cfg.device.nPdBias = 1;
    cfg.device.intCal = 0;

    return cfg;
}

ADS1299Settings makeAdsSettings(AdsPreset preset)
{
    switch (preset) {
        case AdsPreset::DefaultSettings:    return DefaultSettings();
        case AdsPreset::SingleChannelTest:  return SingleChannelTest();
        case AdsPreset::AllChannelsMeasurement: return AllChannelsMeasurement();
    }
    return DefaultSettings();  // unreachable, keeps compiler happy without -Wswitch complaints masking a real bug
}
```

## src/ads1299_configs.hpp
```c
#pragma once

#include "ads1299_driver.hpp"

enum class AdsPreset {
    SingleChannelTest,   // only uses single channel at 1000 sps, gain 8
    DefaultSettings,
    AllChannelsMeasurement
};

/**
 * @brief Returns a fully-populated settings struct for a known configuration.
 */
ADS1299Settings makeAdsSettings(AdsPreset preset);
```

## src/ads1299_definitions.h
```c
/**
 * @file ads1299_definitions.h
 * @author Karl Gerber
 * @brief This file defines commands and reigsters of ads1299
 * @version 0.1
 * @date 2026-07-07
 * 
 * @copyright Copyright (c) 2026
 * 
 */

#pragma once // Exclude multiple includes

#define CMD_WAKEUP  0x02
#define CMD_STANDBY 0x04
#define CMD_RESET   0x06
#define CMD_START   0x08
#define CMD_STOP    0x0A
#define CMD_RDATAC  0x10
#define CMD_SDATAC  0x11
#define CMD_RDATA   0x12

#define CMD_RREG    0x20
#define CMD_WREG    0x40

#define REG_ID      0x00
#define REG_CONFIG1 0x01
#define REG_CONFIG2 0x02
#define REG_CONFIG3 0x03
#define REG_LOFF    0x04
#define REG_CH1SET  0x05
#define REG_CH2SET  0x06
#define REG_CH3SET  0x07
#define REG_CH4SET  0x08
#define REG_CH5SET  0x09
#define REG_CH6SET  0x0A
#define REG_CH7SET  0x0B
#define REG_CH8SET  0x0C
#define REG_BIAS_SENSP  0x0D
#define REG_BIAS_SENSN  0x0E
#define REG_LOFF_SENSP  0x0F
#define REG_LOFF_SENSN  0x10
#define REG_LOFF_FLIP   0x11
#define REG_LOFF_STATP  0x12
#define REG_LOFF_STATN  0x13
#define REG_GPIO        0x14
#define REG_MISC1       0x15
#define REG_MISC2       0x16
#define REG_CONFIG4     0x17

#define ADS_NUM_DEVICES 2
#define ADS_NUM_CHANNELS    8 // daisy chain
#define ADS_BYTES_PER_DEVICE 27
#define ADS_DAISY_FRAME_BYTES (ADS_NUM_DEVICES * ADS_BYTES_PER_DEVICE)
```

## src/ads1299_driver.c
```c
/**
 * @file ads1299_driver.c
 * @author your name (you@domain.com)
 * @brief 
 * @version 0.1
 * @date 2026-07-07
 * 
 * @copyright Copyright (c) 2026
 * 
 */

#include "ads1299_driver.h"

int ads_spi_write_bytes(const uint8_t *data, size_t len)
{
    struct spi_buf txb = {
        .buf = (void *)data,
        .len = len,
    };
    struct spi_buf_set txs = {
        .buffers = &txb,
        .count = 1,
    };

    return spi_write_dt(&ads_spi, &txs);
}

int ads_spi_transceive_bytes(const uint8_t *tx_data,
                    uint8_t *rx_data,
                    size_t len)
{
    struct spi_buf txb = {
        .buf = (void *)tx_data,
        .len = len,
    };
    struct spi_buf_set txs = {
        .buffers = &txb,
        .count = 1,
    };

    struct spi_buf rxb = {
        .buf = rx_data,
        .len = len,
    };
    struct spi_buf_set rxs = {
        .buffers = &rxb,
        .count = 1,
    };

    return spi_transceive_dt(&ads_spi, &txs, &rxs);
}

int ads_send_cmd(uint8_t cmd)
{
    int ret = ads_spi_write_bytes(&cmd, 1);

    /*
     * ADS1299 commands require decode time. The datasheet says commands
     * require 4 tCLK cycles to decode/execute [17].
     */
    k_busy_wait(10);

    return ret;
}

int ads_read_reg(uint8_t reg, uint8_t *value)
{
    uint8_t tx[4] = {
        (uint8_t)(CMD_RREG | reg),
        0x00,
        0x00,
    };
    uint8_t rx[4] = { 0 };

    int ret = ads_spi_transceive_bytes(tx, rx, sizeof(tx));
    if (ret == 0) {
        *value = rx[3];
    }

    return ret;
}

int ads_write_reg(uint8_t reg, uint8_t value)
{
    uint8_t tx[4] = {
        (uint8_t)(CMD_WREG | reg),
        0x00,
        value,
    };

    int ret = ads_spi_write_bytes(tx, sizeof(tx));
    k_busy_wait(10);
    return ret;
}

int ads_write_regs(uint8_t start_reg, const uint8_t *values, size_t count)
{
    uint8_t tx[3 + ADS_NUM_CHANNELS];   /* cmd + count_byte + up to 8 data bytes */

    if (count == 0 || count > ADS_NUM_CHANNELS) {
        return -EINVAL;
    }

    tx[0] = (uint8_t)(CMD_WREG | start_reg);
    tx[1] = (uint8_t)(count - 1);
    memcpy(&tx[2], values, count);

    int ret = ads_spi_write_bytes(tx, 2 + count);
    k_busy_wait(10);
    return ret;
}

int32_t ads_decode24(const uint8_t *p)
{
    int32_t v = ((int32_t)p[0] << 16) |
                ((int32_t)p[1] << 8)  |
                ((int32_t)p[2]);

    if (v & 0x800000) {
        v |= (int32_t)0xFF000000;
    }

    return v;
}

/*
 * In RDATAC mode, after DRDY goes low, clock out:
 * 24 status bits + 24 bits per channel.
 * For 8 channels this is 27 bytes total [22], [23].
 */
int ads_read_frame_rdatac(uint8_t frame[ADS_FRAME_BYTES])
{
    uint8_t tx[ADS_FRAME_BYTES] = { 0 };
    uint8_t rx[ADS_FRAME_BYTES] = { 0 };

    int ret = ads_spi_transceive_bytes(tx, rx, sizeof(tx));
    if (ret) {
        return ret;
    }

    memcpy(frame, rx, ADS_FRAME_BYTES);
    return 0;
}

void ads_hw_reset(void)
{
    gpio_pin_set_dt(&reset_pin, 1);
    k_sleep(K_MSEC(10));

    gpio_pin_set_dt(&reset_pin, 0);
    k_sleep(K_MSEC(50));
}

int ads_read_id(uint8_t *id)
{
    int ret;

    /*
     * Device defaults to RDATAC after power-up; stop continuous mode before
     * register reads/writes [25].
     */
    ret = ads_send_cmd(CMD_SDATAC);
    if (ret) {
        return ret;
    }

    k_sleep(K_MSEC(2));

    return ads_read_reg(REG_ID, id);
}

int ads_dump_test_regs(void)
{
    int ret;
    uint8_t v;

    const uint8_t regs[] = {
        REG_ID,
        REG_CONFIG1,
        REG_CONFIG2,
        REG_CONFIG3,
        REG_CH1SET,
        REG_CH2SET,
        REG_CH3SET,
        REG_CH4SET,
        REG_CH5SET,
        REG_CH6SET,
        REG_CH7SET,
        REG_CH8SET,
    };

    for (size_t i = 0; i < sizeof(regs); i++) {
        ret = ads_read_reg(regs[i], &v);
        if (ret) {
            printk("REG 0x%02X read failed: %d\n", regs[i], ret);
            return ret;
        }

        printk("REG 0x%02X = 0x%02X\n", regs[i], v);
    }

    return 0;
}

int ads_configure_external_inputs_all(void)
{
    int ret;

    /* Stop continuous data mode and conversions before writing registers */
    ret = ads_send_cmd(CMD_SDATAC);
    if (ret) {
        return ret;
    }
    k_sleep(K_MSEC(2));

    ret = ads_send_cmd(CMD_STOP);
    if (ret) {
        return ret;
    }
    k_sleep(K_MSEC(2));

    /* CONFIG1 = 0x96: 250 SPS, DAISY disabled, internal clock (same as you had) */
    ret = ads_write_reg(REG_CONFIG1, 0x96);
    if (ret) {
        return ret;
    }

    /* CONFIG2 = 0xC0: INT_CAL=0 → internal test signals disabled [8] */
    ret = ads_write_reg(REG_CONFIG2, 0xC0);
    if (ret) {
        return ret;
    }

    /* CONFIG3 = 0xE0: PD_REFBUF=1 (enable internal reference buffer) [5] */
    ret = ads_write_reg(REG_CONFIG3, 0xE0);
    if (ret) {
        return ret;
    }

    /*
     * CHnSET = 0x60:
     *   PDn = 0 (powered), GAIN = 110 (x24), SRB2 = 0, MUX = 000 (normal electrode input) [9].
     *   Do this for all eight channels.
     */
    const uint8_t chset_all[ADS_NUM_CHANNELS] = {
        0x60, 0x60, 0x60, 0x60,
        0x60, 0x60, 0x60, 0x60,
    };
    ret = ads_write_regs(REG_CH1SET, chset_all, sizeof(chset_all));
    if (ret) {
        return ret;
    }

    k_sleep(K_MSEC(2));
    printk("ADS1299 external input mode registers written\n");
    return 0;
}


int ads_configure_internal_test_signal(void)
{
    int ret;

    /*
     * CHnSET = 0x05:
     *   PDn = 0     : channel powered up
     *   GAINn = 000 : PGA gain 1
     *   SRB2 = 0
     *   MUXn = 101  : internal test signal
     *
     * CHnSET[2:0] = 101 selects the internally generated test signals [12], [19].
     */
    const uint8_t chset_all[ADS_NUM_CHANNELS] = {
        0x05, 0x05, 0x05, 0x05,
        0x05, 0x05, 0x05, 0x05,
    };

    printk("Configuring ADS1299 internal test signal mode...\n");

    /*
     * Stop continuous data mode before writing registers. RDATAC is the
     * default after power-up and is cancelled with SDATAC [25].
     */
    ret = ads_send_cmd(CMD_SDATAC);
    if (ret) {
        return ret;
    }
    k_sleep(K_MSEC(2));

    /*
     * Optional but clean: stop conversions while configuring.
     */
    ret = ads_send_cmd(CMD_STOP);
    if (ret) {
        return ret;
    }
    k_sleep(K_MSEC(2));

    /*
     * CONFIG1 = 0x96:
     *   Reserved bit7 = 1
     *   DAISY_EN = 0 / standalone-style setting requested
     *   CLK_EN = 0
     *   Reserved bits4:3 = 10
     *   DR[2:0] = 110 -> 250 SPS [10], [13].
     */
    ret = ads_write_reg(REG_CONFIG1, 0x96);
    if (ret) {
        return ret;
    }

    /*
     * CONFIG2 = 0xD0:
     *   INT_CAL = 1 -> internally generated test signal
     *   CAL_AMP = 0 -> 1x test amplitude
     *   CAL_FREQ = 00 -> fCLK / 2^21 pulsed signal [13], [28].
     */
    ret = ads_write_reg(REG_CONFIG2, 0xD0);
    if (ret) {
        return ret;
    }

    /*
     * CONFIG3 = 0xE0:
     *   PD_REFBUF = 1 -> enable internal reference buffer
     *   reserved bits6:5 = 11
     *   BIASREF_INT = 0 in strict bit decoding for 0xE0.
     *
     * Note: the user-requested value is 0xE0. In the ADS1299 register map,
     * BIASREF_INT is bit 3, so setting BIASREF_INT = 1 would make this 0xE8
     * if no other bits change [21], [28]. The datasheet's test-signal flow
     * explicitly shows WREG CONFIG3 E0h when using the internal reference [6],
     * so this code writes 0xE0 as requested.
     */
    ret = ads_write_reg(REG_CONFIG3, 0xE0);
    if (ret) {
        return ret;
    }

    ret = ads_write_regs(REG_CH1SET, chset_all, sizeof(chset_all));
    if (ret) {
        return ret;
    }

    k_sleep(K_MSEC(2));

    printk("ADS1299 internal test signal registers written\n");
    return 0;
}
```

## src/ads1299_driver.cpp
```c
/**
 * @file ADS1299.cpp
 * @brief Zephyr C++ driver class for the TI ADS1299 8-channel EMG ADC on Skosti board.
 * @version 0.2
 * @date 2026-07-08
 */

#include "ads1299_driver.hpp"
#include "usb_cdc.hpp"

LOG_MODULE_REGISTER(ads1299_driver, LOG_LEVEL_DBG);

ADS1299::ADS1299(const struct spi_dt_spec &spi,
                 const struct gpio_dt_spec &reset_gpio,
                 const struct gpio_dt_spec &start_pin,
                 const struct gpio_dt_spec &drdy_pin,
                 const struct gpio_dt_spec &led_pin,
                 const struct pwm_dt_spec   &ads_clk_pwm)
    : spi_(spi),
      reset_gpio_(reset_gpio),
      start_pin_(start_pin),
      drdy_pin_(drdy_pin),
      led_pin_(led_pin),
      ads_clk_pwm_(ads_clk_pwm)
{
    for (auto &ch : settings.channel) {
        ch.mux = 0;  // normal electrode input
    }
}

int ADS1299::configure(const ADS1299Settings &cfg)
{
    int ret;

    //copy callers config
    settings = cfg; 

    ret = sendCommand(CMD_SDATAC);
    if (ret) return ret;
    k_sleep(K_MSEC(2));

    ret = sendCommand(CMD_STOP);
    if (ret) return ret;
    k_sleep(K_MSEC(2));

    // CONFIG1: bit7=1 fixed, bits4:3=10 fixed -> base 0x90
    uint8_t config1 = 0x90;
    if (settings.device.nDaisyChain) config1 |= 0x40; // DAISY_EN=1
    if (settings.device.clkEn)            config1 |= 0x20;
    switch (settings.device.samplingRate) {
        case 16000: config1 |= 0x00; break;
        case 8000:  config1 |= 0x01; break;
        case 4000:  config1 |= 0x02; break;
        case 2000:  config1 |= 0x03; break;
        case 1000:  config1 |= 0x04; break;
        case 500:   config1 |= 0x05; break;
        case 250:
        default:    config1 |= 0x06; break;
    }
    ret = writeRegister(REG_CONFIG1, config1);
    if (ret) return ret;

    // CONFIG2: bits7:6=11 fixed -> base 0xC0
    uint8_t config2 = 0xC0;
    if (settings.device.intCal) config2 |= 0x10;
    if (settings.device.calAmp) config2 |= 0x04;
    config2 |= (settings.device.calFreq & 0x03);
    ret = writeRegister(REG_CONFIG2, config2);
    if (ret) return ret;

    // CONFIG3: bits6:5=11 fixed -> base 0x60
    uint8_t config3 = 0x60;
    if (settings.device.nPdRefBuf)     config3 |= 0x80;
    if (settings.device.biasMeas)     config3 |= 0x10;
    if (settings.device.biasRefInt)   config3 |= 0x08;
    if (settings.device.nPdBias)       config3 |= 0x04;
    if (settings.device.biasLoffSens) config3 |= 0x02;
    ret = writeRegister(REG_CONFIG3, config3);
    if (ret) return ret;

    // LOFF
    uint8_t loff = (uint8_t)((settings.device.compThreshold & 0x07) << 5) |
                   (uint8_t)((settings.device.iLeadOff      & 0x03) << 2) |
                   (uint8_t)(settings.device.fLeadOff       & 0x03);
    ret = writeRegister(REG_LOFF, loff);
    if (ret) return ret;

    ret = writeRegister(REG_BIAS_SENSP, settings.device.biasSensP);
    if (ret) return ret;
    ret = writeRegister(REG_BIAS_SENSN, settings.device.biasSensN);
    if (ret) return ret;
    ret = writeRegister(REG_LOFF_SENSP, settings.device.loffSensP);
    if (ret) return ret;
    ret = writeRegister(REG_LOFF_SENSN, settings.device.loffSensN);
    if (ret) return ret;
    ret = writeRegister(REG_LOFF_FLIP, settings.device.loffFlip);
    if (ret) return ret;
    ret = writeRegister(REG_GPIO, settings.device.gpio);
    if (ret) return ret;
    ret = writeRegister(REG_MISC1, settings.device.srb1 ? 0x20 : 0x00);
    if (ret) return ret;

    uint8_t config4 = 0x00;
    if (settings.device.singleShot) config4 |= 0x04;
    if (settings.device.nPdLoffComp) config4 |= 0x02;
    ret = writeRegister(REG_CONFIG4, config4);
    if (ret) return ret;

    // Per-channel: build all 8 CHnSET bytes and burst-write in one WREG
    uint8_t chset[ADS_NUM_CHANNELS];
    for (int i = 0; i < ADS_NUM_CHANNELS; i++) {
        uint8_t v = 0;
        if (settings.channel[i].powerDown) v |= 0x80;
        switch (settings.channel[i].gain) {
            case 1:  v |= 0x00; break;
            case 2:  v |= 0x10; break;
            case 4:  v |= 0x20; break;
            case 6:  v |= 0x30; break;
            case 8:  v |= 0x40; break;
            case 12: v |= 0x50; break;
            case 24:
            default: v |= 0x60; break;
        }
        if (settings.channel[i].srb2) v |= 0x08;
        v |= (settings.channel[i].mux & 0x07);
        chset[i] = v;
    }
    ret = writeRegisters(REG_CH1SET, chset, ADS_NUM_CHANNELS);
    if (ret) return ret;

    k_sleep(K_MSEC(2));
    LOG_INF("ADS1299 configured (mux[0]=%u, gain[0]=%u, intCal=%u)",
           settings.channel[0].mux, settings.channel[0].gain, settings.device.intCal);
    return 0;
}

int ADS1299::spiWriteBytes(const uint8_t *data, size_t len)
{
    /*
     * NOTE: designated initializers (.buf = ..., .len = ...) are avoided
     * here on purpose. They're a C++20 feature (GCC accepts them earlier
     * as an extension, but it's not portable across -std= settings), so
     * plain field assignment is used instead for a clean C -> C++ port.
     */
    struct spi_buf txb;
    txb.buf = (void *)data;
    txb.len = len;

    struct spi_buf_set txs;
    txs.buffers = &txb;
    txs.count = 1;

    return spi_write_dt(&spi_, &txs);
}

int ADS1299::spiTransceiveBytes(const uint8_t *tx_data, uint8_t *rx_data, size_t len)
{
    struct spi_buf txb;
    txb.buf = (void *)tx_data;
    txb.len = len;

    struct spi_buf_set txs;
    txs.buffers = &txb;
    txs.count = 1;

    struct spi_buf rxb;
    rxb.buf = rx_data;
    rxb.len = len;

    struct spi_buf_set rxs;
    rxs.buffers = &rxb;
    rxs.count = 1;

    return spi_transceive_dt(&spi_, &txs, &rxs);
}

int ADS1299::sendCommand(uint8_t cmd)
{
    int ret = spiWriteBytes(&cmd, 1);

    /*
     * ADS1299 commands require decode time. The datasheet says commands
     * require 4 tCLK cycles to decode/execute [17].
     */
    k_busy_wait(10);

    return ret;
}

int ADS1299::readRegister(uint8_t reg, uint8_t *value)
{
    uint8_t tx[3] = { (uint8_t)(CMD_RREG | reg), 0x00, 0x00 };
    uint8_t rx[3] = { 0 };
    int ret = spiTransceiveBytes(tx, rx, sizeof(tx));
    if (ret == 0) {
        *value = rx[2];
    }
    return ret;
}

int ADS1299::writeRegister(uint8_t reg, uint8_t value)
{
    uint8_t tx[3] = {
        static_cast<uint8_t>(CMD_WREG | reg),
        0x00,
        value,
    };

    int ret = spiWriteBytes(tx, sizeof(tx));
    k_busy_wait(10);
    return ret;
}

int ADS1299::writeRegisters(uint8_t start_reg, const uint8_t *values, size_t count)
{
    uint8_t tx[3 + ADS_NUM_CHANNELS];   /* cmd + count_byte + up to 8 data bytes */

    if (count == 0 || count > ADS_NUM_CHANNELS) {
        return -EINVAL;
    }

    tx[0] = (uint8_t)(CMD_WREG | start_reg);
    tx[1] = (uint8_t)(count - 1);
    memcpy(&tx[2], values, count);

    int ret = spiWriteBytes(tx, 2 + count);
    k_busy_wait(10);
    return ret;
}
/*
 * In RDATAC mode, after DRDY goes low, clock out:
 * 24 status bits + 24 bits per channel.
 * For 8 channels this is 27 bytes total [22], [23].
 */
int ADS1299::readFrameRdatac(uint8_t frame[ADS_DAISY_FRAME_BYTES])
{
    uint8_t tx[ADS_DAISY_FRAME_BYTES] = { 0 };
    uint8_t rx[ADS_DAISY_FRAME_BYTES] = { 0 };

    int ret = spiTransceiveBytes(tx, rx, sizeof(tx));
    if (ret) {
        return ret;
    }

    memcpy(frame, rx, ADS_DAISY_FRAME_BYTES);
    return 0;
}

void ADS1299::hwReset()
{
    gpio_pin_set_dt(&reset_gpio_, 1);
    k_sleep(K_MSEC(10));

    gpio_pin_set_dt(&reset_gpio_, 0);
    k_sleep(K_MSEC(50));
}

int ADS1299::init(uint8_t *id_out)
{
    int ret;
    uint8_t id = 0;

    k_sleep(K_MSEC(20));

    // 1. hw reset
    hwReset();

    // 2. send reset command
    ret = sendCommand(CMD_RESET);
    if (ret) {
        LOG_ERR("CMD_RESET failed: %d", ret);
        return ret;
    }

    // 3. wait longer than 18 tCLK
    k_sleep(K_MSEC(10));

    // 4. send SDATAC
    ret = stopContinuousRead();
    if (ret) {
        LOG_ERR("ADS1299: SDATAC failed: %d", ret);
        return ret;
    }

    // 5. read ID register
    ret = readRegister(REG_ID, &id);
    if (ret != 0) {
        LOG_ERR("ADS1299: ID register read failed");
        return ret;
    }
    
    // 6. validate device
    /* ADS1299 family ID: lower 5 bits should read 0x1E (Datasheet, REG_ID) */
    if ((id & 0x1F) != 0x1E) {
        LOG_ERR("ADS1299: unexpected ID 0x%02X (expected low 5 bits = 0x1E)", id);
        return -ENODEV;
    }

    LOG_INF("ADS1299 detected, ID = 0x%02X", id);

    *id_out = id;

    // 7. Leave ADS in SDATAC so registers can be configured
    return 0;
}

const char* ADS1299::registerName(uint8_t addr)
{
    switch (addr) {
        case 0x00: return "ID";
        case 0x01: return "CONFIG1";
        case 0x02: return "CONFIG2";
        case 0x03: return "CONFIG3";
        case 0x04: return "LOFF";
        case 0x05: return "CH1SET";
        case 0x06: return "CH2SET";
        case 0x07: return "CH3SET";
        case 0x08: return "CH4SET";
        case 0x09: return "CH5SET";
        case 0x0A: return "CH6SET";
        case 0x0B: return "CH7SET";
        case 0x0C: return "CH8SET";
        case 0x0D: return "BIAS_SENSP";
        case 0x0E: return "BIAS_SENSN";
        case 0x0F: return "LOFF_SENSP";
        case 0x10: return "LOFF_SENSN";
        case 0x11: return "LOFF_FLIP";
        case 0x12: return "LOFF_STATP";
        case 0x13: return "LOFF_STATN";
        case 0x14: return "GPIO";
        case 0x15: return "MISC1";
        case 0x16: return "MISC2";
        case 0x17: return "CONFIG4";
        default:   return "UNKNOWN";
    }
}

int ADS1299::dumpTestRegisters()
{
    int ret;
    uint8_t regs[0x18];

    for (uint8_t addr = 0x00; addr <= 0x17; addr++) {
        ret = readRegister(addr, &regs[addr]);
        if (ret) {
            LOG_ERR("REG 0x%02X read failed: %d", addr, ret);
            return ret;
        }
        k_msleep(2);
    }

    LOG_INF("ADS1299 Register Dump");
    
    for (uint8_t addr = 0x00; addr <= 0x17; addr++) {
        LOG_INF("0x%02X  %-13s 0x%02X", addr, registerName(addr), regs[addr]);
    }

    return 0;
}

int ADS1299::dumpTestRegistersUsb()
{
    int ret;
    uint8_t regs[0x18];

    for (uint8_t addr = 0x00; addr <= 0x17; addr++) {
        ret = readRegister(addr, &regs[addr]);
        if (ret) {
            char errbuf[64];
            int n = snprintf(errbuf, sizeof(errbuf),
                              "REG 0x%02X read failed: %d\r\n", addr, ret);
            if (n > 0) {
                usb_cdc::print(errbuf, (n < (int)sizeof(errbuf)) ? n : sizeof(errbuf) - 1);
            }
            return ret;
        }
        k_msleep(2);
    }

    char line[96];
    int n;

    n = snprintf(line, sizeof(line), "ADS1299 Register Dump:\r\n");
    if (n > 0) {
        usb_cdc::print(line, (n < (int)sizeof(line)) ? n : sizeof(line) - 1);
    }

    n = snprintf(line, sizeof(line), "ADDR  NAME          VALUE\r\n");
    if (n > 0) {
        usb_cdc::print(line, (n < (int)sizeof(line)) ? n : sizeof(line) - 1);
    }

    n = snprintf(line, sizeof(line), "----  ----------    ----\r\n");
    if (n > 0) {
        usb_cdc::print(line, (n < (int)sizeof(line)) ? n : sizeof(line) - 1);
    }

    for (uint8_t addr = 0x00; addr <= 0x17; addr++) {
        n = snprintf(line, sizeof(line), "0x%02X  %-13s 0x%02X\r\n",
                     addr, registerName(addr), regs[addr]);
        if (n > 0) {
            usb_cdc::print(line, (n < (int)sizeof(line)) ? n : sizeof(line) - 1);
        }
    }

    return 0;
}

int ADS1299::stopContinuousRead()
{
    int ret = sendCommand(CMD_SDATAC);
    if (ret) {
        return ret;
    }

    k_sleep(K_MSEC(2));

    return 0;
}

int ADS1299::startContinuousRead()
{
    int ret = sendCommand(CMD_RDATAC);
    if (ret) {
        return ret;
    }

    k_sleep(K_MSEC(2));
    return 0;
}

int ADS1299::startConversions()
{
    int ret = sendCommand(CMD_START);
    if (ret) {
        return ret;
    }

    /*
     * Conversions begin when START pin is high or START command is sent.
     * If using the START command, keep START pin low.
     */
    k_sleep(K_MSEC(20));
    return 0;
}

int ADS1299::stopConversions()
{
    int ret = sendCommand(CMD_STOP);
    if (ret) {
        return ret;
    }

    k_sleep(K_MSEC(2));
    return 0;
}

int32_t ADS1299::decode24(const uint8_t *p)
{
    int32_t v = ((int32_t)p[0] << 16) |
                ((int32_t)p[1] << 8)  |
                ((int32_t)p[2]);

    if (v & 0x800000) {
        v |= (int32_t)0xFF000000;
    }

    return v;
}

/* ------------------------------------------------------------------ */
/*  Static members (defined here, declared in the header)             */
/* ------------------------------------------------------------------ */

struct k_sem ADS1299::drdy_sem;
struct gpio_callback ADS1299::drdy_cb_data_;

/* ------------------------------------------------------------------ */
/*  Board bring-up                                                    */
/* ------------------------------------------------------------------ */

int ADS1299::boardBringUp()
{
    int ret;

    /* 0. Initialise the DRDY semaphore (binary) */
    k_sem_init(&drdy_sem, 0, 1);

    /* 1. Check SPI is ready */
    if (!spi_is_ready_dt(&spi_)) {
        LOG_ERR("SPI device not ready");
        return -ENODEV;
    }

    /* 2. Configure all GPIOs */
    ret = setupGpios();
    if (ret) {
        LOG_ERR("GPIO setup failed: %d", ret);
        return ret;
    }

    /* 3. Keep START pin low — we use the START command over SPI */
    gpio_pin_set_dt(&start_pin_, 0);

    /* 4. Set up DRDY falling-edge interrupt */
    ret = setupDrdyInterrupt();
    if (ret) {
        LOG_ERR("DRDY interrupt setup failed: %d", ret);
        return ret;
    }

    /* 5. Start the PWM clock (~2 MHz) for the ADS1299 external fCLK */
    ret = startAdsPwmClock();
    if (ret) {
        LOG_ERR("Warning: ADS clock not running: %d", ret);
        /* non-fatal — the board may use an external crystal */
    }

    LOG_INF("ADS1299 board bring-up complete");
    return 0;
}

/* ------------------------------------------------------------------ */
/*  Private helpers                                                    */
/* ------------------------------------------------------------------ */

int ADS1299::setupGpios()
{
    int ret;

    if (!gpio_is_ready_dt(&led_pin_) ||
        !gpio_is_ready_dt(&reset_gpio_) ||
        !gpio_is_ready_dt(&start_pin_) ||
        !gpio_is_ready_dt(&drdy_pin_)) {
        LOG_ERR("GPIO not ready");
        return -ENODEV;
    }

    ret = gpio_pin_configure_dt(&led_pin_, GPIO_OUTPUT_INACTIVE);
    if (ret) return ret;

    ret = gpio_pin_configure_dt(&reset_gpio_, GPIO_OUTPUT_INACTIVE);
    if (ret) return ret;

    ret = gpio_pin_configure_dt(&start_pin_, GPIO_OUTPUT_INACTIVE);
    if (ret) return ret;

    ret = gpio_pin_configure_dt(&drdy_pin_, GPIO_INPUT);
    if (ret) return ret;

    return 0;
}

int ADS1299::setupDrdyInterrupt()
{
    int ret = gpio_pin_interrupt_configure_dt(&drdy_pin_, GPIO_INT_EDGE_FALLING);
    if (ret) return ret;

    gpio_init_callback(&drdy_cb_data_, drdyIsr, BIT(drdy_pin_.pin));
    gpio_add_callback(drdy_pin_.port, &drdy_cb_data_);

    return 0;
}

int ADS1299::startAdsPwmClock()
{
    if (!pwm_is_ready_dt(&ads_clk_pwm_)) {
        LOG_ERR("ADS clock PWM not ready");
        return -ENODEV;
    }

    /*
     * ~2 MHz: 500 ns period, 250 ns pulse.
     * ADS1299 typical external fCLK is 2.048 MHz in datasheet examples [14].
     */
    int ret = pwm_set_dt(&ads_clk_pwm_, PWM_NSEC(500), PWM_NSEC(250));
    if (ret) {
        LOG_ERR("PWM start failed: %d", ret);
        return ret;
    }

    LOG_INF("ADS clock PWM started");
    return 0;
}

void ADS1299::drdyIsr(const struct device *dev,
                      struct gpio_callback *cb,
                      uint32_t pins)
{
    k_sem_give(&drdy_sem);
}
```

## src/ads1299_driver.h
```c
/**
 * @file ads1299_driver.h
 * @author your name (you@domain.com)
 * @brief 
 * @version 0.1
 * @date 2026-07-07
 * 
 * @copyright Copyright (c) 2026
 * 
 */

#include <zephyr/kernel.h>
#include <zephyr/sys/printk.h>
#include <zephyr/drivers/spi.h>
#include <zephyr/drivers/gpio.h>
#include <zephyr/drivers/pwm.h>

#include <stdint.h>
#include <stddef.h>
#include <string.h>

#include "ads1299_definitions.h"

int ads_spi_write_bytes(const uint8_t *data, size_t len);

int ads_spi_transceive_bytes(const uint8_t *tx_data,
                    uint8_t *rx_data,
                    size_t len);

int ads_send_cmd(uint8_t cmd);

int ads_read_reg(uint8_t reg, uint8_t *value);

int ads_write_reg(uint8_t reg, uint8_t value);

int ads_write_regs(uint8_t start_reg, const uint8_t *values, size_t count);

int32_t ads_decode24(const uint8_t *p);

int ads_read_frame_rdatac(uint8_t frame[ADS_FRAME_BYTES]);

void ads_hw_reset(void);

int ads_read_id(uint8_t *id);

int ads_dump_test_regs(void);

int ads_configure_external_inputs_all(void);

int ads_configure_internal_test_signal(void);
```

## src/bhi360_driver.hpp
```c
/**
 * @file bhi360_driver.hpp
 * @brief BHI360 firmware, SPI, FIFO, and callback integration.
 */
#pragma once

#include <stddef.h>

/** Initialize all configured BHI360 devices. */
void bhi360_init(void);

/** Poll and process FIFO data for all initialized BHI360 devices. */
void bhi360_process_fifo(void);
```

## src/threads.hpp
```c
/**
 * @file threads.hpp
 * @brief Thread declarations and shared packet structures for Sokosti EMG acquisition.
 * @version 0.1
 * @date 2026-07-29
 */

#pragma once

#include <zephyr/kernel.h>
#include <zephyr/drivers/gpio.h>

#include <stdint.h>

#include "ads1299_definitions.h"

/* ---------------------------------------------------------------------------
 * Forward declarations — objects owned by main.cpp
 * ------------------------------------------------------------------------- */
class ADS1299;

extern ADS1299               ads;
extern const struct gpio_dt_spec led;
extern int32_t               last_ch1_code;

/* ---------------------------------------------------------------------------
 * Packet structures shared between acquisition and USB-output threads
 * ------------------------------------------------------------------------- */

#pragma pack(push, 1)
struct SamplePacket {
    uint8_t  sync[2];      // 0xAA 0x55 — resync marker for the host parser
    uint32_t sample_idx;
    uint8_t  status1_ok;
    uint8_t  status2_ok;
    uint8_t  ch_data[48];  // 16 channels * 3 bytes raw, unmodified 24-bit values
    uint8_t  checksum;     // simple XOR or sum, so host can detect a corrupted packet
};
#pragma pack(pop)

struct SampleBatch {
    SamplePacket samples[8];  // BATCH_SIZE = 8
};

/* ---------------------------------------------------------------------------
 * Message queue — defined by K_MSGQ_DEFINE in threads.cpp
 * ------------------------------------------------------------------------- */
extern struct k_msgq batch_queue;

/* ---------------------------------------------------------------------------
 * Thread setup — called once from main() after ADS initialisation
 * ------------------------------------------------------------------------- */
void threads_setup(void);
```
